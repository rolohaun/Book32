// Ultra Hop - an original side-scrolling platformer for the Arduboy.
// Controls: LEFT/RIGHT move, B jump (hold for higher), A run, UP pause.
// Graphics and levels live in assets.h, generated by tools/gen_assets.js.

// Inkade: Arduboy2, Arduboy2Beep and EEPROM come from ArduboyCompat.h.
#include "assets.h"
#include "types.h"

Arduboy2 arduboy;

// ---------------------------------------------------------------------------
// Tuning. Positions and speeds are in 1/16 pixel ("sub") units.
// ---------------------------------------------------------------------------

constexpr uint8_t SUB_SHIFT = 4;
constexpr int16_t WALK_MAX = 14;
constexpr int16_t RUN_MAX = 22;
constexpr int16_t ACCEL = 1;
constexpr int16_t SKID = 3;
constexpr int16_t FRICTION = 3;
constexpr int16_t JUMP_V = 41;
constexpr int16_t JUMP_V_RUN = 44;
constexpr int16_t GRAV_FALL = 5;  // rising with jump held uses 1.75 (2, 2, 2, 1)
constexpr int16_t MAX_FALL = 44;
constexpr int16_t STOMP_V = 28;
constexpr int16_t STOMP_V_HELD = 36;
constexpr uint8_t COYOTE_FRAMES = 5;
constexpr uint8_t JUMP_BUFFER_FRAMES = 6;
constexpr uint8_t INVULN_FRAMES = 90;
constexpr uint8_t TIME_TICK_FRAMES = 24;

constexpr uint8_t HERO_W = 6;
constexpr uint8_t HERO_H_SMALL = 8;
constexpr uint8_t HERO_H_BIG = 15;
constexpr uint8_t CAM_LEAD = 48;
constexpr int16_t POLE_BASE_Y = 56;  // the ground line under the flag pole

constexpr uint8_t ROWS = 8;
constexpr uint8_t MAX_ENTITIES = 6;
constexpr uint8_t START_LIVES = 3;
constexpr uint8_t ICE_WORLD = 2;  // world index with slippery ground

// Bat flight path, pixels
const int8_t FLYER_WAVE[16] PROGMEM = { 0, 2, 4, 5, 6, 5, 4, 2, 0, -2, -4, -5, -6, -5, -4, -2 };

// ---------------------------------------------------------------------------
// Sound effects: pairs of (BeepPin1 count, frames). A count of 0 is a rest.
// ---------------------------------------------------------------------------

#define N(hz, frames) BeepPin1::freq(hz), frames
const uint16_t SFX_JUMP[] PROGMEM = { N(330, 2), N(440, 2), N(587, 2), N(784, 2), 0, 0 };
const uint16_t SFX_COIN[] PROGMEM = { N(988, 4), N(1319, 10), 0, 0 };
const uint16_t SFX_STOMP[] PROGMEM = { N(262, 3), N(196, 3), N(131, 3), 0, 0 };
const uint16_t SFX_BUMP[] PROGMEM = { N(110, 5), 0, 0 };
const uint16_t SFX_BREAK[] PROGMEM = { N(160, 2), N(100, 2), N(220, 2), N(80, 4), 0, 0 };
const uint16_t SFX_SPROUT[] PROGMEM = { N(392, 3), N(523, 3), N(659, 3), N(784, 3), 0, 0 };
const uint16_t SFX_POWERUP[] PROGMEM = { N(523, 3), N(659, 3), N(784, 3), N(1047, 3), N(784, 3), N(1047, 3), N(1319, 6), 0, 0 };
const uint16_t SFX_HURT[] PROGMEM = { N(659, 4), N(440, 4), N(294, 4), N(196, 6), 0, 0 };
const uint16_t SFX_DIE[] PROGMEM = { N(494, 6), N(698, 6), 0, 6, N(698, 6), N(698, 8), N(659, 8), N(587, 8), N(523, 16), 0, 0 };
const uint16_t SFX_CLEAR[] PROGMEM = { N(523, 8), N(659, 8), N(784, 8), N(1047, 16), N(784, 8), N(1047, 30), 0, 0 };
const uint16_t SFX_TICK[] PROGMEM = { N(1568, 1), 0, 0 };
const uint16_t SFX_ONEUP[] PROGMEM = { N(659, 5), N(784, 5), N(1319, 5), N(1047, 5), N(1175, 5), N(1568, 8), 0, 0 };
const uint16_t SFX_START[] PROGMEM = { N(659, 6), N(659, 6), 0, 6, N(659, 6), 0, 6, N(523, 6), N(659, 8), 0, 4, N(784, 12), 0, 0 };
const uint16_t SFX_GAMEOVER[] PROGMEM = { N(523, 10), N(392, 10), N(330, 10), N(262, 30), 0, 0 };
#undef N

const uint16_t* sfxPtr = nullptr;
uint8_t sfxWait = 0;

void playSfx(const uint16_t* sfx) {
  sfxPtr = sfx;
  sfxWait = 0;
}

void updateSfx() {
  if (!sfxPtr) return;
  if (sfxWait) {
    sfxWait--;
    return;
  }
  uint16_t count = pgm_read_word(sfxPtr);
  uint8_t frames = pgm_read_word(sfxPtr + 1);
  if (frames == 0) {
    sfxPtr = nullptr;
    BeepPin1::noTone();
    return;
  }
  sfxPtr += 2;
  if (count && arduboy.audio.enabled()) BeepPin1::tone(count);
  else BeepPin1::noTone();
  sfxWait = frames - 1;
}

// ---------------------------------------------------------------------------
// State
// ---------------------------------------------------------------------------

Mode mode = Mode::Title;
uint16_t modeTimer = 0;
bool paused = false;

// Level
const uint8_t* levelCols;  // one column-dictionary index per level column
const uint8_t* levelDict;  // the world's unique columns, ROWS tile ids each
uint8_t levelIndex;
uint8_t world;  // 0-based; picks the tile theme
uint8_t levelW;
uint8_t consumed[LEVEL_MAX_WIDTH];  // bit y set = tile (x, y) has been used up
uint8_t nextSpawnCol;
int16_t camX;  // pixels
int16_t poleX;  // pixel x of the flag pole
int16_t flagY;

// Hero
int16_t heroX, heroY;  // top-left of hitbox, sub units
int16_t heroVX, heroVY;
bool heroBig;
bool heroOnGround;
bool heroFacingLeft;
bool heroVisible;
uint8_t coyote, jumpBuffer;
uint8_t invuln;
uint16_t walkAnim;

// Session
uint8_t lives;
uint8_t coins;
uint32_t score;
uint32_t hiScore;
uint8_t unlockedWorlds = 1;
uint8_t selectedWorld;
uint16_t timeLeft;
uint8_t timeTick;

Entity entities[MAX_ENTITIES];

// Effects
uint8_t bumpTX, bumpTY, bumpT;
int16_t popX, popY;
int8_t popVY;
uint8_t popT;
struct Debris {
  int16_t x, y;
  int8_t vx, vy;
};
Debris debris[4];
uint8_t debrisT;

// ---------------------------------------------------------------------------
// Save data (EEPROM): magic, high score, worlds unlocked
// ---------------------------------------------------------------------------

constexpr int EE_ADDR = EEPROM_STORAGE_SPACE_START + 420;
constexpr uint16_t EE_MAGIC = 0x4855;  // "UH"

void loadSave() {
  uint16_t magic;
  EEPROM.get(EE_ADDR, magic);
  hiScore = 0;
  unlockedWorlds = 1;
  if (magic != EE_MAGIC) return;
  EEPROM.get(EE_ADDR + 2, hiScore);
  unlockedWorlds = EEPROM.read(EE_ADDR + 6);
  if (unlockedWorlds < 1 || unlockedWorlds > WORLD_COUNT) unlockedWorlds = 1;
}

void writeSave() {
  EEPROM.put(EE_ADDR, EE_MAGIC);
  EEPROM.put(EE_ADDR + 2, hiScore);
  EEPROM.update(EE_ADDR + 6, unlockedWorlds);
}

void saveHiScore() {
  if (score <= hiScore) return;
  hiScore = score;
  writeSave();
}

// ---------------------------------------------------------------------------
// Level access
// ---------------------------------------------------------------------------

inline bool isSolid(uint8_t t) { return t >= T_GROUND; }

uint8_t tileAt(int16_t tx, int16_t ty) {
  if (tx < 0 || tx >= levelW || ty < 0 || ty >= ROWS) return T_EMPTY;
  uint8_t col = pgm_read_byte(levelCols + tx);
  uint8_t t = pgm_read_byte(levelDict + col * ROWS + ty);
  if (consumed[tx] & (1 << ty)) return (t == T_QCOIN || t == T_QPOWER) ? T_USED : T_EMPTY;
  return t;
}

void consume(int16_t tx, int16_t ty) { consumed[tx] |= 1 << ty; }

// Pixel coordinates. The level edges are walls; above and below the screen is open.
bool solidAt(int16_t px, int16_t py) {
  if (px < 0 || px >= levelW * 8) return true;
  if (py < 0 || py >= ROWS * 8) return false;
  return isSolid(tileAt(px >> 3, py >> 3));
}

// Any solid tile along a vertical line from top to bottom (inclusive).
bool solidColumn(int16_t px, int16_t top, int16_t bottom) {
  for (int16_t y = top;; y += 8) {
    if (y > bottom) y = bottom;
    if (solidAt(px, y)) return true;
    if (y == bottom) return false;
  }
}

void addScore(uint16_t pts) { score += pts; }

void addCoin() {
  addScore(200);
  if (++coins >= 100) {
    coins = 0;
    lives++;
    playSfx(SFX_ONEUP);
  } else {
    playSfx(SFX_COIN);
  }
}

Entity* spawnEntity(uint8_t type, int16_t px, int16_t py) {
  for (Entity& e : entities) {
    if (e.type != E_NONE) continue;
    e.type = type;
    e.state = S_ACTIVE;
    e.timer = 0;
    e.x = px << SUB_SHIFT;
    e.y = py << SUB_SHIFT;
    e.vx = type == E_SPIKY ? -6 : -8;
    e.vy = type == E_FLYER ? py : 0;  // flyers keep their base height here
    return &e;
  }
  return nullptr;
}

void spawnColumns() {
  int16_t lastCol = (camX + WIDTH + 8) >> 3;
  while (nextSpawnCol < levelW && nextSpawnCol <= lastCol) {
    for (uint8_t ty = 0; ty < ROWS; ty++) {
      uint8_t t = tileAt(nextSpawnCol, ty);
      uint8_t type = t == T_SPAWN_WALKER ? E_WALKER : t == T_SPAWN_SPIKY ? E_SPIKY : t == T_SPAWN_FLYER ? E_FLYER : E_NONE;
      if (type == E_NONE) continue;
      consume(nextSpawnCol, ty);
      spawnEntity(type, nextSpawnCol * 8, ty * 8);
    }
    nextSpawnCol++;
  }
}

void loadLevel(uint8_t index) {
  levelIndex = index;
  levelCols = (const uint8_t*)pgm_read_ptr(&LEVEL_DATA[index]);
  world = pgm_read_byte(&LEVEL_WORLD[index]);
  levelDict = (const uint8_t*)pgm_read_ptr(&WORLD_COLUMNS[world]);
  levelW = pgm_read_byte(&LEVEL_WIDTH[index]);
  memset(consumed, 0, sizeof(consumed));
  memset(entities, 0, sizeof(entities));
  bumpT = popT = debrisT = 0;

  poleX = 0;
  for (uint8_t tx = 0; tx < levelW && !poleX; tx++)
    for (uint8_t ty = 0; ty < ROWS; ty++)
      if (tileAt(tx, ty) == T_POLE_TOP) {
        poleX = tx * 8 + 3;
        flagY = (ty + 1) * 8;
      }

  heroX = (2 * 8 + 1) << SUB_SHIFT;
  heroY = (6 * 8) << SUB_SHIFT;
  if (heroBig) heroY -= (HERO_H_BIG - HERO_H_SMALL) << SUB_SHIFT;
  heroVX = heroVY = 0;
  heroOnGround = false;
  heroFacingLeft = false;
  heroVisible = true;
  coyote = jumpBuffer = invuln = 0;
  walkAnim = 0;

  camX = 0;
  nextSpawnCol = 0;
  timeLeft = pgm_read_word(&LEVEL_TIME[index]);
  timeTick = 0;
  paused = false;
}

void setMode(Mode m) {
  mode = m;
  modeTimer = 0;
}

void startIntro() {
  loadLevel(levelIndex);
  setMode(Mode::Intro);
  playSfx(SFX_START);
}

void newGame() {
  lives = START_LIVES;
  coins = 0;
  score = 0;
  heroBig = false;
  levelIndex = pgm_read_byte(&WORLD_START[selectedWorld]);
  startIntro();
}

// ---------------------------------------------------------------------------
// Hero
// ---------------------------------------------------------------------------

inline uint8_t heroH() { return heroBig ? HERO_H_BIG : HERO_H_SMALL; }

void killHero() {
  if (mode != Mode::Play) return;
  heroBig = false;
  heroVX = 0;
  heroVY = 0;
  invuln = 0;
  setMode(Mode::Dying);
  playSfx(SFX_DIE);
}

void hurtHero() {
  if (invuln) return;
  if (heroBig) {
    heroBig = false;
    heroY += (HERO_H_BIG - HERO_H_SMALL) << SUB_SHIFT;
    invuln = INVULN_FRAMES;
    playSfx(SFX_HURT);
  } else {
    killHero();
  }
}

void growHero() {
  addScore(1000);
  playSfx(SFX_POWERUP);
  if (heroBig) return;
  heroBig = true;
  heroY -= (HERO_H_BIG - HERO_H_SMALL) << SUB_SHIFT;
}

void bumpBlock(int16_t tx, int16_t ty) {
  uint8_t t = tileAt(tx, ty);
  bool bump = true;
  if (t == T_QCOIN) {
    consume(tx, ty);
    addCoin();
    popX = tx * 8;
    popY = (ty * 8 - 8) << SUB_SHIFT;
    popVY = -40;
    popT = 24;
  } else if (t == T_QPOWER) {
    consume(tx, ty);
    Entity* e = spawnEntity(E_BERRY, tx * 8, ty * 8);
    if (e) {
      e->state = S_RISING;
      e->timer = 16;
      e->vx = 10;
    }
    playSfx(SFX_SPROUT);
  } else if (t == T_BRICK && heroBig) {
    consume(tx, ty);
    addScore(50);
    playSfx(SFX_BREAK);
    bump = false;
    int16_t cx = (tx * 8 + 2) << SUB_SHIFT, cy = (ty * 8 + 2) << SUB_SHIFT;
    for (uint8_t i = 0; i < 4; i++) {
      debris[i].x = cx + ((i & 1) ? 4 << SUB_SHIFT : 0);
      debris[i].y = cy + ((i & 2) ? 4 << SUB_SHIFT : 0);
      debris[i].vx = (i & 1) ? 12 : -12;
      debris[i].vy = (i & 2) ? -32 : -48;
    }
    debrisT = 60;
  } else {
    playSfx(SFX_BUMP);
  }
  if (bump) {
    bumpTX = tx;
    bumpTY = ty;
    bumpT = 8;
  }

  // Knock out anything standing on the block.
  int16_t top = ty * 8, left = tx * 8;
  for (Entity& e : entities) {
    if (e.type == E_NONE || e.state != S_ACTIVE) continue;
    int16_t ex = e.x >> SUB_SHIFT, eb = (e.y >> SUB_SHIFT) + 8;
    if (ex + 7 < left || ex > left + 7 || eb < top - 2 || eb > top + 1) continue;
    if (e.type == E_BERRY) {
      e.vy = -32;
    } else {
      e.state = S_SQUASHED;
      e.timer = 30;
      addScore(100);
    }
  }
}

void collectCoins() {
  int16_t l = heroX >> SUB_SHIFT, t = heroY >> SUB_SHIFT;
  int16_t r = l + HERO_W - 1, b = t + heroH() - 1;
  for (int16_t y = t;; y += 8) {
    if (y > b) y = b;
    for (int16_t x = l;; x = r) {
      if (y >= 0 && tileAt(x >> 3, y >> 3) == T_COIN) {
        consume(x >> 3, y >> 3);
        addCoin();
      }
      if (x == r) break;
    }
    if (y == b) break;
  }
}

void updateHero() {
  bool run = arduboy.pressed(A_BUTTON);
  int8_t dir = arduboy.pressed(RIGHT_BUTTON) ? 1 : arduboy.pressed(LEFT_BUTTON) ? -1 : 0;
  int16_t maxSpeed = run ? RUN_MAX : WALK_MAX;
  bool slip = heroOnGround && world == ICE_WORLD;

  // Horizontal acceleration. On ice, grip is halved and friction quartered.
  if (dir) {
    if (heroVX * dir < 0) heroVX += dir * (heroOnGround && !slip ? SKID : ACCEL);
    else if (abs(heroVX) < maxSpeed) {
      if (!slip || (arduboy.frameCount & 1)) heroVX += dir * ACCEL;
    } else if (heroOnGround && abs(heroVX) > maxSpeed) heroVX -= dir;
    if (heroOnGround) heroFacingLeft = dir < 0;
  } else if (heroOnGround) {
    int16_t f = slip ? ((arduboy.frameCount & 3) == 0) : FRICTION;
    if (heroVX > f) heroVX -= f;
    else if (heroVX < -f) heroVX += f;
    else heroVX = 0;
  }

  // Jumping, with a little coyote time and input buffering
  if (arduboy.justPressed(B_BUTTON)) jumpBuffer = JUMP_BUFFER_FRAMES;
  else if (jumpBuffer) jumpBuffer--;
  if (heroOnGround) coyote = COYOTE_FRAMES;
  else if (coyote) coyote--;
  if (jumpBuffer && coyote) {
    heroVY = -(abs(heroVX) > WALK_MAX + 4 ? JUMP_V_RUN : JUMP_V);
    jumpBuffer = coyote = 0;
    playSfx(SFX_JUMP);
  }

  if (heroVY < 0 && arduboy.pressed(B_BUTTON)) heroVY += (arduboy.frameCount & 3) ? 2 : 1;
  else heroVY += GRAV_FALL;
  if (heroVY > MAX_FALL) heroVY = MAX_FALL;

  uint8_t h = heroH();

  // Move X
  heroX += heroVX;
  int16_t l = heroX >> SUB_SHIFT, t = heroY >> SUB_SHIFT;
  if (l < camX) {
    l = camX;
    heroX = l << SUB_SHIFT;
    if (heroVX < 0) heroVX = 0;
  }
  if (heroVX > 0 && solidColumn(l + HERO_W - 1, t, t + h - 1)) {
    heroX = ((((l + HERO_W - 1) >> 3) << 3) - HERO_W) << SUB_SHIFT;
    heroVX = 0;
  } else if (heroVX < 0 && solidColumn(l, t, t + h - 1)) {
    heroX = (((l >> 3) + 1) << 3) << SUB_SHIFT;
    heroVX = 0;
  }

  // Move Y
  heroY += heroVY;
  l = heroX >> SUB_SHIFT;
  t = heroY >> SUB_SHIFT;
  int16_t r = l + HERO_W - 1, b = t + h - 1;
  heroOnGround = false;
  if (heroVY > 0 && (solidAt(l, b) || solidAt(r, b))) {
    heroY = (((b >> 3) << 3) - h) << SUB_SHIFT;
    heroVY = 0;
    heroOnGround = true;
  } else if (heroVY < 0 && (solidAt(l, t) || solidAt(r, t))) {
    heroY = (((t >> 3) + 1) << 3) << SUB_SHIFT;
    heroVY = 0;
    int16_t centerTX = (l + HERO_W / 2) >> 3;
    int16_t tx = solidAt(centerTX * 8, t) ? centerTX : (solidAt(l, t) ? l >> 3 : r >> 3);
    bumpBlock(tx, t >> 3);
  }

  collectCoins();

  if (tileAt(l >> 3, b >> 3) == T_LAVA || tileAt(r >> 3, b >> 3) == T_LAVA) {
    killHero();
    return;
  }

  if (heroOnGround && heroVX) walkAnim += abs(heroVX);
  if (invuln) invuln--;

  // Fell into a pit
  if ((heroY >> SUB_SHIFT) >= ROWS * 8 + 8) {
    killHero();
    return;
  }

  // Reached the flag pole
  if (poleX && (heroX >> SUB_SHIFT) + HERO_W >= poleX) {
    heroX = (poleX - HERO_W) << SUB_SHIFT;
    heroVX = heroVY = 0;
    heroFacingLeft = false;
    int16_t height = POLE_BASE_Y - ((heroY >> SUB_SHIFT) + h);
    addScore(height > 40 ? 5000 : height > 24 ? 2000 : height > 8 ? 800 : 100);
    setMode(Mode::Clear);
    playSfx(SFX_CLEAR);
  }
}

// ---------------------------------------------------------------------------
// Entities
// ---------------------------------------------------------------------------

void updateEntity(Entity& e) {
  if (e.state == S_SQUASHED) {
    if (--e.timer == 0) e.type = E_NONE;
    return;
  }
  if (e.type == E_FLYER) {
    // Swoops along a wave, ignoring tiles
    e.x += e.vx;
    e.timer++;
    e.y = (e.vy + (int8_t)pgm_read_byte(&FLYER_WAVE[(e.timer >> 2) & 15])) << SUB_SHIFT;
    if ((e.x >> SUB_SHIFT) < camX - 24) e.type = E_NONE;
    return;
  }
  if (e.state == S_RISING) {
    if (arduboy.frameCount & 1) e.y -= 1 << SUB_SHIFT;
    if (--e.timer == 0) e.state = S_ACTIVE;
    return;
  }

  // Horizontal: turn around at walls
  e.x += e.vx;
  int16_t l = (e.x >> SUB_SHIFT) + 1, r = l + 5, t = e.y >> SUB_SHIFT, b = t + 7;
  if (e.vx > 0 ? solidColumn(r, t + 1, b) : solidColumn(l, t + 1, b)) {
    e.x -= e.vx;
    e.vx = -e.vx;
  }

  // Vertical
  e.vy = min(e.vy + GRAV_FALL, (int)MAX_FALL);
  e.y += e.vy;
  l = (e.x >> SUB_SHIFT) + 1;
  r = l + 5;
  t = e.y >> SUB_SHIFT;
  b = t + 7;
  if (e.vy > 0 && (solidAt(l, b) || solidAt(r, b))) {
    int16_t floorY = (b >> 3) << 3;
    e.y = (floorY - 8) << SUB_SHIFT;
    e.vy = 0;
    // Spikies stay on their platform
    if (e.type == E_SPIKY && !solidAt(e.vx > 0 ? r + 1 : l - 1, floorY)) e.vx = -e.vx;
  }

  int16_t ex = e.x >> SUB_SHIFT;
  if (t > ROWS * 8 || ex < camX - 24 || ex > camX + WIDTH + 64) e.type = E_NONE;
}

void touchEntities() {
  int16_t hl = heroX >> SUB_SHIFT, ht = heroY >> SUB_SHIFT;
  int16_t hr = hl + HERO_W - 1, hb = ht + heroH() - 1;
  for (Entity& e : entities) {
    if (e.type == E_NONE || e.state != S_ACTIVE) continue;
    int16_t el = (e.x >> SUB_SHIFT) + 1, et = (e.y >> SUB_SHIFT) + 2;
    int16_t er = el + 5, eb = et + 5;
    if (hr < el || hl > er || hb < et || ht > eb) continue;

    if (e.type == E_BERRY) {
      e.type = E_NONE;
      growHero();
    } else if ((e.type == E_WALKER || e.type == E_FLYER) && heroVY > 0 && hb <= et + 4) {
      e.state = S_SQUASHED;
      e.timer = 30;
      addScore(100);
      heroVY = -(arduboy.pressed(B_BUTTON) ? STOMP_V_HELD : STOMP_V);
      playSfx(SFX_STOMP);
    } else {
      hurtHero();
      if (mode != Mode::Play) return;
    }
  }
}

void updateEffects() {
  if (bumpT) bumpT--;
  if (popT) {
    popT--;
    popY += popVY;
    popVY += 4;
  }
  if (debrisT) {
    debrisT--;
    for (Debris& d : debris) {
      d.x += d.vx;
      d.y += d.vy;
      if (d.vy < MAX_FALL) d.vy += 4;
    }
  }
}

void updateCamera() {
  int16_t target = (heroX >> SUB_SHIFT) - CAM_LEAD;
  int16_t maxCam = levelW * 8 - WIDTH;
  if (target > maxCam) target = maxCam;
  if (target > camX) camX = target;
}

void updateTimer() {
  if (++timeTick < TIME_TICK_FRAMES) return;
  timeTick = 0;
  if (timeLeft) timeLeft--;
  if (timeLeft == 100) playSfx(SFX_TICK);
  if (timeLeft == 0) killHero();
}

// ---------------------------------------------------------------------------
// Drawing
// ---------------------------------------------------------------------------

// OR an 8x8 tile into the screen buffer at any y.
void blitTile(int16_t sx, int16_t sy, uint8_t tile) {
  if (sx <= -8 || sx >= WIDTH || sy <= -8 || sy >= HEIGHT) return;
  const uint8_t* gfx = TILE_GFX + tile * 8;
  if (tile == T_LAVA && (arduboy.frameCount & 16)) gfx = LAVA_ALT_GFX;
  if (world) {
    int8_t slot = tile == T_GROUND ? 0 : tile == T_BRICK ? 1 : tile == T_HARD ? 2 : tile == T_CLOUD_L ? 3 : tile == T_CLOUD_R ? 4 : -1;
    if (slot >= 0) gfx = THEME_GFX + ((world - 1) * THEMED_TILES + slot) * 8;
  }
  uint8_t* buf = arduboy.sBuffer;
  int8_t page = sy >> 3;
  uint8_t shift = sy & 7;
  for (uint8_t i = 0; i < 8; i++) {
    int16_t x = sx + i;
    if (x < 0 || x >= WIDTH) continue;
    uint8_t col = pgm_read_byte(gfx + i);
    if (page >= 0) buf[page * WIDTH + x] |= col << shift;
    if (shift && page + 1 < ROWS) buf[(page + 1) * WIDTH + x] |= col >> (8 - shift);
  }
}

void drawLevel() {
  int16_t firstCol = camX >> 3;
  int16_t offset = camX & 7;
  for (uint8_t c = 0; c <= WIDTH / 8; c++) {
    int16_t tx = firstCol + c;
    if (tx >= levelW) break;
    int16_t sx = c * 8 - offset;
    for (uint8_t ty = 0; ty < ROWS; ty++) {
      uint8_t t = tileAt(tx, ty);
      if (t == T_EMPTY || t == T_SPAWN_WALKER || t == T_SPAWN_SPIKY || t == T_SPAWN_FLYER) continue;
      int16_t sy = ty * 8;
      if (bumpT && tx == bumpTX && ty == bumpTY) sy -= bumpT > 4 ? 8 - bumpT : bumpT;
      blitTile(sx, sy, t);
    }
  }
}

void drawEntity(const Entity& e) {
  int16_t sx = (e.x >> SUB_SHIFT) - camX, sy = e.y >> SUB_SHIFT;
  switch (e.type) {
    case E_WALKER:
      Sprites::drawPlusMask(sx, sy, WALKER, e.state == S_SQUASHED ? 2 : (arduboy.frameCount >> 3) & 1);
      break;
    case E_SPIKY:
      Sprites::drawPlusMask(sx, sy, SPIKY, ((arduboy.frameCount >> 3) & 1) + (e.vx < 0 ? SPIKY_FRAMES : 0));
      break;
    case E_BERRY:
      Sprites::drawPlusMask(sx, sy, BERRY, 0);
      break;
    case E_FLYER:
      if (e.state != S_SQUASHED) Sprites::drawPlusMask(sx, sy, FLYER, (arduboy.frameCount >> 3) & 1);
      break;
  }
}

void drawHero() {
  if (!heroVisible) return;
  if (invuln && (invuln & 4)) return;
  int16_t sx = (heroX >> SUB_SHIFT) - camX - 1;
  int16_t sy = heroY >> SUB_SHIFT;
  uint8_t frame;
  if (mode == Mode::Dying) frame = 4;
  else if (!heroOnGround) frame = 3;
  else if (heroVX == 0) frame = 0;
  else frame = 1 + ((walkAnim >> 7) & 1);

  if (heroBig) {
    if (frame > 3) frame = 3;
    Sprites::drawPlusMask(sx, sy - 1, HERO_BIG, frame + (heroFacingLeft ? HERO_BIG_FRAMES : 0));
  } else {
    Sprites::drawPlusMask(sx, sy, HERO_SMALL, frame + (heroFacingLeft && frame != 4 ? HERO_SMALL_FRAMES : 0));
  }
}

void printPadded(uint32_t v, uint8_t digits) {
  uint32_t limit = 1;
  for (uint8_t i = 1; i < digits; i++) limit *= 10;
  for (; limit > 1 && v < limit; limit /= 10) arduboy.print('0');
  arduboy.print(v);
}

void drawHud() {
  arduboy.fillRect(0, 0, WIDTH, 7, BLACK);
  blitTile(0, -1, T_COIN);
  arduboy.setCursor(9, 0);
  arduboy.print('x');
  printPadded(coins, 2);
  arduboy.setCursor(40, 0);
  printPadded(score, 6);
  arduboy.setCursor(98, 0);
  arduboy.print('T');
  printPadded(timeLeft, 3);
}

void drawWorld() {
  // Rising power-ups go under the tiles so they appear to come out of the block.
  for (const Entity& e : entities)
    if (e.type != E_NONE && e.state == S_RISING) drawEntity(e);
  drawLevel();
  if (poleX) Sprites::drawPlusMask(poleX - 8 - camX, flagY, FLAG, 0);
  if (popT) blitTile(popX - camX, popY >> SUB_SHIFT, T_COIN);
  if (debrisT)
    for (const Debris& d : debris)
      arduboy.fillRect((d.x >> SUB_SHIFT) - camX, d.y >> SUB_SHIFT, 2, 2, WHITE);
  for (const Entity& e : entities)
    if (e.type != E_NONE && e.state != S_RISING) drawEntity(e);
  drawHud();
  drawHero();
}

void printCentered(const __FlashStringHelper* s, int16_t y, uint8_t size = 1) {
  arduboy.setTextSize(size);
  arduboy.setCursor((WIDTH - strlen_P((const char*)s) * 6 * size) / 2, y);
  arduboy.print(s);
  arduboy.setTextSize(1);
}

// ---------------------------------------------------------------------------
// Modes
// ---------------------------------------------------------------------------

void titleMode() {
  if (arduboy.justPressed(UP_BUTTON) || arduboy.justPressed(DOWN_BUTTON)) {
    if (arduboy.audio.enabled()) arduboy.audio.off();
    else arduboy.audio.on();
    arduboy.audio.saveOnOff();
    playSfx(SFX_COIN);
  }
  if (arduboy.justPressed(LEFT_BUTTON) && selectedWorld > 0) selectedWorld--;
  if (arduboy.justPressed(RIGHT_BUTTON) && selectedWorld + 1 < unlockedWorlds) selectedWorld++;
  world = selectedWorld;
  if (arduboy.justPressed(A_BUTTON) || arduboy.justPressed(B_BUTTON)) {
    newGame();
    return;
  }

  printCentered(F("ULTRA HOP"), 4, 2);
  uint8_t bounce = (arduboy.frameCount >> 4) & 1;
  Sprites::drawPlusMask(38, 23 - bounce * 2, HERO_SMALL, bounce ? 3 : 0);
  Sprites::drawPlusMask(60, 24, WALKER, (arduboy.frameCount >> 3) & 1);
  Sprites::drawPlusMask(82, 24, BERRY, 0);
  for (int16_t x = 0; x < WIDTH; x += 8) blitTile(x, 32, T_GROUND);
  if (unlockedWorlds > 1) {
    arduboy.setCursor(28, 42);
    arduboy.print(selectedWorld > 0 ? F("< ") : F("  "));
    arduboy.print(F("WORLD "));
    arduboy.print(selectedWorld + 1);
    if (selectedWorld + 1 < unlockedWorlds) arduboy.print(F(" >"));
  } else if ((arduboy.frameCount >> 5) & 1) {
    printCentered(F("PRESS A OR B"), 42);
  }
  arduboy.setCursor(0, 56);
  arduboy.print(F("HI "));
  printPadded(hiScore, 6);
  arduboy.setCursor(74, 56);
  arduboy.print(arduboy.audio.enabled() ? F("SOUND ON") : F("SOUND --"));
}

void introMode() {
  arduboy.setCursor(37, 16);
  arduboy.print(F("WORLD "));
  arduboy.print(world + 1);
  arduboy.print('-');
  arduboy.print(pgm_read_byte(&LEVEL_NUMBER[levelIndex]));
  Sprites::drawPlusMask(48, 32, heroBig ? HERO_BIG : HERO_SMALL, 0);
  arduboy.setCursor(62, 36);
  arduboy.print(F("x "));
  arduboy.print(lives);
  if (++modeTimer > 150 || (modeTimer > 30 && arduboy.justPressed(A_BUTTON | B_BUTTON))) setMode(Mode::Play);
}

void playMode() {
  if (arduboy.justPressed(UP_BUTTON)) paused = !paused;
  if (paused) {
    drawWorld();
    arduboy.fillRect(34, 22, 60, 20, BLACK);
    arduboy.drawRect(34, 22, 60, 20, WHITE);
    printCentered(F("PAUSED"), 25);
    printCentered(F("DOWN:QUIT"), 33);
    if (arduboy.justPressed(DOWN_BUTTON)) {
      saveHiScore();
      setMode(Mode::Title);
    }
    return;
  }

  updateHero();
  if (mode == Mode::Play) {
    for (Entity& e : entities)
      if (e.type != E_NONE) updateEntity(e);
    touchEntities();
  }
  updateEffects();
  updateCamera();
  spawnColumns();
  if (mode == Mode::Play) updateTimer();
  drawWorld();
}

void dyingMode() {
  modeTimer++;
  if (modeTimer == 30 && (heroY >> SUB_SHIFT) < ROWS * 8) heroVY = -48;
  if (modeTimer > 30) {
    heroVY = min(heroVY + 3, 64);
    heroY += heroVY;
  }
  updateEffects();
  drawWorld();
  if (modeTimer > 170) {
    if (--lives == 0) {
      saveHiScore();
      setMode(Mode::GameOver);
      playSfx(SFX_GAMEOVER);
    } else {
      startIntro();
    }
  }
}

void clearMode() {
  modeTimer++;
  constexpr int16_t baseY = POLE_BASE_Y;
  uint8_t h = heroH();
  if (modeTimer < 200 && (heroY >> SUB_SHIFT) + h < baseY) {
    // Slide down the pole with the flag
    heroY += 24;
    if ((heroY >> SUB_SHIFT) + h > baseY) heroY = (baseY - h) << SUB_SHIFT;
    if (flagY < baseY - 8) flagY++;
    heroOnGround = false;
    modeTimer = 1;
  } else if (modeTimer < 70) {
    // Hop off and walk away
    heroFacingLeft = false;
    heroX += WALK_MAX;
    heroVY = min(heroVY + GRAV_FALL, (int)MAX_FALL);
    heroY += heroVY;
    int16_t l = heroX >> SUB_SHIFT, b = (heroY >> SUB_SHIFT) + h - 1;
    heroOnGround = false;
    if (solidAt(l, b) || solidAt(l + HERO_W - 1, b)) {
      heroY = (((b >> 3) << 3) - h) << SUB_SHIFT;
      heroVY = 0;
      heroOnGround = true;
    }
    walkAnim += WALK_MAX;
    heroVX = WALK_MAX;
    updateCamera();
  } else if (timeLeft) {
    // Convert the remaining time to points
    heroVisible = false;
    uint8_t step = timeLeft >= 2 ? 2 : 1;
    timeLeft -= step;
    addScore(50 * step);
    if ((arduboy.frameCount & 3) == 0) playSfx(SFX_TICK);
    modeTimer = 70;
  } else if (modeTimer > 130) {
    if (++levelIndex >= LEVEL_COUNT) {
      saveHiScore();
      setMode(Mode::Win);
      playSfx(SFX_ONEUP);
    } else {
      uint8_t next = pgm_read_byte(&LEVEL_WORLD[levelIndex]);
      if (next + 1 > unlockedWorlds) {
        unlockedWorlds = next + 1;
        selectedWorld = next;
        writeSave();
      }
      startIntro();
    }
    return;
  }
  updateEffects();
  drawWorld();
}

void gameOverMode() {
  printCentered(F("GAME OVER"), 20, 1);
  arduboy.setCursor(28, 36);
  arduboy.print(F("SCORE "));
  printPadded(score, 6);
  if (++modeTimer > 240 || (modeTimer > 60 && arduboy.justPressed(A_BUTTON | B_BUTTON))) setMode(Mode::Title);
}

void winMode() {
  printCentered(F("YOU WIN!"), 6, 2);
  printCentered(F("THANKS FOR PLAYING"), 28);
  arduboy.setCursor(28, 44);
  arduboy.print(F("SCORE "));
  printPadded(score, 6);
  Sprites::drawPlusMask(60, 54 - ((arduboy.frameCount >> 3) & 3), HERO_SMALL, 3);
  if (++modeTimer > 90 && arduboy.justPressed(A_BUTTON | B_BUTTON)) setMode(Mode::Title);
}

// ---------------------------------------------------------------------------

void setup() {
  arduboy.begin();
  arduboy.setFrameRate(60);
  BeepPin1::begin();
  loadSave();
}

void loop() {
  if (!arduboy.nextFrame()) return;
  arduboy.pollButtons();
  updateSfx();
  arduboy.clear();

  switch (mode) {
    case Mode::Title: titleMode(); break;
    case Mode::Intro: introMode(); break;
    case Mode::Play: playMode(); break;
    case Mode::Dying: dyingMode(); break;
    case Mode::Clear: clearMode(); break;
    case Mode::GameOver: gameOverMode(); break;
    case Mode::Win: winMode(); break;
  }

  arduboy.display();
}
